## board/qualcomm/generic/qcom.its
```
/*
 * U-Boot FIT source for Samsung Galaxy Tab A7 (gta4l) mainline kernel
 */
/dts-v1/;

/ {
	description = "gta4l mainline kernel";
	#address-cells = <1>;

	images {
		kernel-1 {
			description = "Linux 6.10.0-postmarketos-qcom-sm6115";
			data = /incbin/("qcom_imgs/Image");
			type = "kernel";
			arch = "arm64";
			os = "linux";
			compression = "none";
			load = <0x80000000>;
			entry = <0x80000000>;
			hash-1 {
				algo = "sha1";
			};
		};

		ramdisk-1 {
			description = "postmarketOS initramfs";
			data = /incbin/("qcom_imgs/initramfs.cpio.gz");
			type = "ramdisk";
			arch = "arm64";
			os = "linux";
			compression = "gzip";
			load = <0x0>;
			entry = <0x0>;
			hash-1 {
				algo = "sha1";
			};
		};

		fdt-1 {
			description = "sm6115-samsung-gta4l-fdt";
			data = /incbin/("qcom_imgs/sm6115-samsung-gta4l.dtb");
			type = "flat_dt";
			arch = "arm64";
			compression = "none";
			hash-1 {
				algo = "sha1";
			};
		};
	};

	configurations {
		default = "config-1";

		config-1 {
			description = "gta4l mainline kernel";
			kernel = "kernel-1";
			ramdisk = "ramdisk-1";
			fdt = "fdt-1";
		};
	};
};
```
